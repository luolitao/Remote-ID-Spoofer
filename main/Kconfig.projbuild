## main/Kconfig.projbuild
```kconfig
menu "Remote ID Spoofer Configuration"

    config SPOOF_MAC_ADDRESS
        string "Spoof MAC Address"
        default "60:60:1f:d3:B2:6a"
        help
            MAC address to use for spoofing. Format: XX:XX:XX:XX:XX:XX
            If empty, a random MAC will be generated on each boot.

    config BEACON_SSID
        string "Beacon SSID"
        default "ESP_SPOOF"
        help
            SSID name for the beacon frames

    config BEACON_CHANNEL
        int "Beacon Channel"
        default 6
        range 1 13
        help
            WiFi channel for broadcasting (1-13)

    config TX_INTERVAL_MS
        int "Transmission Interval (ms)"
        default 500
        help
            Interval between beacon transmissions in milliseconds

endmenu
```

## sdkconfig.defaults
```kconfig
CONFIG_ESP_WIFI_ENABLED=y
CONFIG_ESP_SOFTAP_SUPPORT=y
CONFIG_ESP_WIFI_SOFTAP_SUPPORT=y
CONFIG_LWIP_IPV4=y
CONFIG_FREERTOS_HZ=1000
CONFIG_CONSOLE_UART_DEFAULT=y
CONFIG_ESPTOOLPY_FLASHSIZE_4MB=y
```
